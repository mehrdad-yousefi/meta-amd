## meta-r1000/conf/layer.conf
```bitbake
# We have a conf and classes directory, add to BBPATH
BBPATH .= ":${LAYERDIR}"

# We have a recipes-* directories, add to BBFILES
BBFILES += "${LAYERDIR}/recipes-*/*/*.bb \
	${LAYERDIR}/recipes-*/*/*.bbappend"

BBFILE_COLLECTIONS += "r1000"
BBFILE_PATTERN_r1000 = "^${LAYERDIR}/"
BBFILE_PRIORITY_r1000 = "14"
LAYERSERIES_COMPAT_r1000 = "sumo"

LAYERDEPENDS_r1000 = "amd openembedded-layer meta-python"
```
