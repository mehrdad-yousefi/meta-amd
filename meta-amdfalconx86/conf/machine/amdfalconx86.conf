## meta-amdfalconx86/conf/machine/amdfalconx86.conf
```bitbake
#@TYPE: Machine
#@NAME: amdfalconx86

#@DESCRIPTION: Machine configuration for amdfalconx86 systems

POKY_DEFAULT_DISTRO_FEATURES_remove = "wayland"

PREFERRED_PROVIDER_virtual/kernel ?= "${@bb.utils.contains('RT_KERNEL_AMD', 'yes', "linux-yocto-rt", "linux-yocto", d)}"
#PREFERRED_VERSION_linux-yocto-rt ?= "4.1%"
PREFERRED_VERSION_linux-yocto ?= "4.4%"
PREFERRED_VERSION_libdrm = "2.4.66"
PREFERRED_VERSION_gstreamer1.0-omx = "git+git%"

require conf/machine/include/tune-amdfalconx86.inc

include conf/machine/include/amd-common-configurations.inc


MACHINE_FEATURES += "wifi efi pcbios alsa"


# Disable GPU if RT kernel is in use
XSERVER_X86_AMDGPU = "xf86-video-amd \
           ${@bb.utils.contains('DISTRO_FEATURES', 'opengl', 'mesa-driver-radeonsi', '', d)} \
           "
XSERVER_X86_NOGPU = "${@bb.utils.contains('DISTRO_FEATURES', 'opengl', 'mesa-driver-swrast', '', d)}"
XSERVER_X86_GPU = "${@bb.utils.contains('RT_KERNEL_AMD', 'yes', "${XSERVER_X86_NOGPU}", "${XSERVER_X86_AMDGPU}", d)}"

XSERVER ?= "${XSERVER_X86_BASE} \
            ${XSERVER_X86_EXT} \
            ${XSERVER_X86_FBDEV} \
            ${XSERVER_X86_MODESETTING} \
            ${XSERVER_X86_GPU} \
           "


MACHINE_EXTRA_RRECOMMENDS += "kernel-modules amdgpu-firmware alsa-utils libmad mpv"
MACHINE_EXTRA_RRECOMMENDS += "vdpauinfo gstreamer1.0-omx amdvlk vulkan-sdk"
MACHINE_EXTRA_RRECOMMENDS += "grub parted util-linux-blkid"
MACHINE_EXTRA_RRECOMMENDS += "rtc-test watchdog-test smbus-test gpio-test spi-test"

MACHINE_EXTRA_RRECOMMENDS += "amdgpu-firmware amd-acp-rt286-load"

KERNEL_MODULE_AUTOLOAD += "amd_gnb_bus snd-soc-acp-pcm snd-soc-acp-rt286-mach"

# Setup a gettys on all serial ports
SERIAL_CONSOLES = "115200;ttyS0 115200;ttyUSB0"

# These are only needed for Bettongs where console doesn't
# work on ttyS0/ttyS1 so we hope to at least get a getty running
# on ttyS4/ttyS5
SERIAL_CONSOLES += "115200;ttyS4 115200;ttyS5"

# Enable the kernel console on ttyS0/COM0
APPEND += "console=ttyS0,115200n8"

# Enable powerplay
APPEND += "amdgpu.powerplay=1"

MACHINEOVERRIDES =. "amd:amdx86:amdgpu:"
```

## meta-r1000/conf/machine/r1000.conf
```bitbake
#@TYPE: Machine
#@NAME: r1000

#@DESCRIPTION: Machine configuration for r1000 systems

# BSP and PATCH versions for MEL releases
BSP_VERSION = "0"
PATCH_VERSION = "0"

PREFERRED_PROVIDER_virtual/kernel ?= "linux-yocto"
PREFERRED_VERSION_linux-yocto ?= "4.14%"
PREFERRED_PROVIDER_llvm ?= "llvm7.0"

require conf/machine/include/tune-r1000.inc

# Add machine specific AMD features and feature pkgs here
VULKAN_PKGS_r1000 = "amdvlk glslang spirv-tools vulkan-loader-layers rgp"
AMD_PLATFORM_SPECIFIC_PKGS_r1000 += "opencl"

include conf/machine/include/amd-common-configurations.inc
include conf/machine/include/amd-customer-configurations.inc

# GPU
XSERVER_X86_GPU = "xf86-video-amd \
           ${@bb.utils.contains('DISTRO_FEATURES', 'opengl', 'mesa-driver-radeonsi', '', d)} \
           "

XSERVER ?= "${XSERVER_X86_BASE} \
            ${XSERVER_X86_EXT} \
            ${XSERVER_X86_FBDEV} \
            ${XSERVER_X86_MODESETTING} \
            ${XSERVER_X86_GPU} \
           "

KERNEL_MODULE_AUTOLOAD += "snd-soc-acp-pcm snd-soc-acp-rt286-mach amdgpu"
MACHINE_EXTRA_RRECOMMENDS += "amdgpu-firmware grub-efi"
MACHINE_EXTRA_RRECOMMENDS_remove = "rtc-test smbus-test grub"

# Setup a getty on all serial ports
SERIAL_CONSOLES ?= "115200;ttyS4 115200;ttyS5"

# Enable the kernel console on ttyS4/USB0 as well
KERNEL_SERIAL_CONSOLE ?= "console=ttyS4,115200n8"

TOOLCHAIN_HOST_TASK_append_mel = " ${@bb.utils.contains('INCLUDE_VULKAN', 'yes', "nativesdk-glslang", "", d)}"

MACHINEOVERRIDES =. "amd:amdx86:amdgpu:"

# Metadata used by CodeBench for the ADE
ADE_CB_CPU = "general.cpu.zen"
```
